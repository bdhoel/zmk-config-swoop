## boards/shields/Kconfig.shield
```kconfig
# Copyright (c) 2024 Ridwan Abdullah
# SPDX-License-Identifier: MIT

config SHIELD_SWOOP_LEFT
    def_bool $(shields_list_contains,swoop_left)

config SHIELD_SWOOP_RIGHT
    def_bool $(shields_list_contains,swoop_right)
```
